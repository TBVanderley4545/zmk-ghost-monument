## boards/shields/ghost_monument/Kconfig.defconfig
```kconfig
if SHIELD_GHOST_MONUMENT_LEFT

# Name must be less than 16 characters long!
config ZMK_KEYBOARD_NAME
    default "Ghost Monument"

config ZMK_SPLIT_ROLE_CENTRAL
    default y

endif

if SHIELD_GHOST_MONUMENT_LEFT || SHIELD_GHOST_MONUMENT_RIGHT

config ZMK_SPLIT
    default y

endif
```

## config/boards/shields/ghost_monument/Kconfig.shield
```kconfig
config SHIELD_GHOST_MONUMENT_LEFT
    def_bool $(shields_list_contains,ghost_monument_left)

config SHIELD_GHOST_MONUMENT_RIGHT
    def_bool $(shields_list_contains,ghost_monument_right)
```
